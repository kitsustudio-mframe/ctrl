/**
 * Copyright (c) 2020 ZxyKira
 * All rights reserved.
 *
 * SPDX-License-Identifier: MIT
 */

/* ****************************************************************************************
 * Include
 */
#include "./SerialPortInputStream.h"

//-----------------------------------------------------------------------------------------

/* ****************************************************************************************
 * Macro
 */

/* ****************************************************************************************
 * Using
 */
using mframe::ctrl::SerialPortInputStream;

//-----------------------------------------------------------------------------------------

/* ****************************************************************************************
 * Variable <Static>
 */

/* ****************************************************************************************
 * Construct Method
 */

//-----------------------------------------------------------------------------------------
SerialPortInputStream::SerialPortInputStream(mframe::hal::usart::USART& base) : mBase(base) {
  this->mBase.setEventReceiver(this);
  return;
}

//-----------------------------------------------------------------------------------------
SerialPortInputStream::~SerialPortInputStream(void) {
  this->mBase.beginReceiver(false);
  this->mBase.setEventReceiver(nullptr);
  this->abortRead();
  return;
}

/* ****************************************************************************************
 * Operator Method
 */

/* ****************************************************************************************
 * Public Method <Static>
 */

/* ****************************************************************************************
 * Public Method <Override>
 */

//-----------------------------------------------------------------------------------------
bool SerialPortInputStream::onUartReceiver(const uint8_t data) {
  if (this->mWriteBuffer == nullptr)
    return false;

  int result = this->mWriteBuffer->putByte(reinterpret_cast<const char&>(data));

  if (result >= 0)
    ++this->mResult;

  if (result <= 0) {
    this->execute();
    return false;

  } else {
    return true;
  }
}

/* ****************************************************************************************
 * Public Method
 */

/* ****************************************************************************************
 * Protected Method <Static>
 */

/* ****************************************************************************************
 * Protected Method <Override>
 */

//-----------------------------------------------------------------------------------------
void SerialPortInputStream::onReadEvent(void) {
  this->mBase.beginReceiver(true);
  return;
}

/* ****************************************************************************************
 * Protected Method
 */

/* ****************************************************************************************
 * Private Method
 */

/* ****************************************************************************************
 * End of file
 */
